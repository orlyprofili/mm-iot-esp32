## examples/iperf/sdkconfig.defaults.esp32s3
```kconfig
#
# ESP32S3-specific
#
CONFIG_ESP32S3_INSTRUCTION_CACHE_32KB=y
CONFIG_ESP32S3_DEFAULT_CPU_FREQ_240=y

# Flash configuration
#CONFIG_ESPTOOLPY_OCT_FLASH=y
CONFIG_ESPTOOLPY_FLASHSIZE_4MB=y
CONFIG_ESPTOOLPY_FLASHMODE_DIO=y
```
